## Kconfig
```kconfig
# SPDX-License-Identifier: GPL-2.0

mainmenu "Linux/$(ARCH) $(KERNELVERSION) Kernel Configuration"

source "$(srctree)/Kconfig.base"

source "$(KBUILD_EXT_TREE)/drivers/pci/controller/dwc/Kconfig"

source "$(KBUILD_EXT_TREE)/drivers/misc/Kconfig"

source "$(KBUILD_EXT_TREE)/drivers/clk/gs/Kconfig"

source "$(KBUILD_EXT_TREE)/drivers/soc/google/Kconfig"

source "$(KBUILD_EXT_TREE)/drivers/input/Kconfig"

source "$(KBUILD_EXT_TREE)/drivers/char/hw_random/Kconfig"

source "$(KBUILD_EXT_TREE)/drivers/tty/serial/Kconfig"

source "$(KBUILD_EXT_TREE)/drivers/scsi/ufs/Kconfig"

source "$(KBUILD_EXT_TREE)/drivers/i2c/busses/Kconfig"

source "$(KBUILD_EXT_TREE)/drivers/usb/Kconfig"

source "$(KBUILD_EXT_TREE)/drivers/rtc/Kconfig"

source "$(KBUILD_EXT_TREE)/drivers/dma/Kconfig"

source "$(KBUILD_EXT_TREE)/drivers/dma-buf/heaps/Kconfig"

source "$(KBUILD_EXT_TREE)/drivers/spi/Kconfig"

source "$(KBUILD_EXT_TREE)/drivers/pinctrl/Kconfig"

source "$(KBUILD_EXT_TREE)/drivers/power/Kconfig"

source "$(KBUILD_EXT_TREE)/drivers/thermal/Kconfig"

source "$(KBUILD_EXT_TREE)/drivers/trusty/Kconfig"

source "$(KBUILD_EXT_TREE)/drivers/watchdog/Kconfig"

source "$(KBUILD_EXT_TREE)/drivers/regulator/Kconfig"

source "$(KBUILD_EXT_TREE)/drivers/mfd/Kconfig"

source "$(KBUILD_EXT_TREE)/drivers/media/platform/Kconfig"

source "$(KBUILD_EXT_TREE)/drivers/video/Kconfig"

source "$(KBUILD_EXT_TREE)/drivers/clocksource/Kconfig"

source "$(KBUILD_EXT_TREE)/drivers/iommu/Kconfig"

source "$(KBUILD_EXT_TREE)/drivers/cpufreq/Kconfig"

source "$(KBUILD_EXT_TREE)/drivers/devfreq/google/Kconfig"

source "$(KBUILD_EXT_TREE)/drivers/iio/Kconfig"

source "$(KBUILD_EXT_TREE)/drivers/phy/Kconfig"

source "$(KBUILD_EXT_TREE)/drivers/staging/android/Kconfig"

source "$(KBUILD_EXT_TREE)/drivers/bts/Kconfig"
```

## drivers/dma-buf/heaps/Kconfig
```kconfig
config DMABUF_HEAPS_DEFERRED_FREE
	tristate

config DMABUF_HEAPS_PAGE_POOL
	tristate

source "$(KBUILD_EXT_TREE)/drivers/dma-buf/heaps/samsung/Kconfig"
```

## drivers/gpu/exynos/Kconfig
```kconfig
menu "Exynos Graphic Devices"
source "$(KBUILD_EXT_TREE)/drivers/gpu/exynos/g2d/Kconfig"
endmenu
```

## drivers/i2c/Kconfig
```kconfig
# SPDX-License-Identifier: GPL-2.0-only
#

if I2C
source "device-modules/drivers/i2c/busses/Kconfig"
endif # I2C
```

## drivers/iio/Kconfig
```kconfig
# SPDX-License-Identifier: GPL-2.0-only
#
# Industrial I/O subsystem configuration
#

if IIO

source "$(KBUILD_EXT_TREE)/drivers/iio/power/Kconfig"

endif # IIO
```

## drivers/input/misc/Kconfig
```kconfig
# SPDX-License-Identifier: GPL-2.0-only
#
# Input misc drivers configuration
#

if INPUT_MISC

source "$(KBUILD_EXT_TREE)/drivers/input/misc/vl53l1/Kconfig"

endif
```

## drivers/phy/Kconfig
```kconfig
# SPDX-License-Identifier: GPL-2.0-only
#
# PHY
#

source "$(KBUILD_EXT_TREE)/drivers/phy/samsung/Kconfig"
```

## drivers/power/Kconfig
```kconfig
# SPDX-License-Identifier: GPL-2.0-only
source "$(KBUILD_EXT_TREE)/drivers/power/reset/Kconfig"
```

## drivers/scsi/ufs/Kconfig
```kconfig
# SPDX-License-Identifier: GPL-2.0-only

config SCSI_UFS_PIXEL
	tristate "EXYNOS UFS Host Controller Driver"
	depends on SCSI_UFSHCD && SCSI_UFSHCD_PLATFORM
	help
	  This selects the EXYNOS UFS host controller driver which
	  run with Exynos SoCs.

	  If you have a controller with this interface, say Y or M here.
```

## drivers/thermal/Kconfig
```kconfig
# SPDX-License-Identifier: GPL-2.0-only
#
# Generic thermal drivers configuration
#

if THERMAL

menu "Samsung thermal drivers"
depends on (ARCH_EXYNOS || SOC_GOOGLE) || COMPILE_TEST
source "$(KBUILD_EXT_TREE)/drivers/thermal/samsung/Kconfig"
source "$(KBUILD_EXT_TREE)/drivers/thermal/google/Kconfig"
endmenu

endif
```

## drivers/usb/Kconfig
```kconfig
# SPDX-License-Identifier: GPL-2.0
#
# USB device configuration
#

if USB_SUPPORT

if USB

source "$(KBUILD_EXT_TREE)/drivers/usb/host/Kconfig"

endif

source "$(KBUILD_EXT_TREE)/drivers/usb/dwc3/Kconfig"

source "$(KBUILD_EXT_TREE)/drivers/usb/gadget/Kconfig"

source "$(KBUILD_EXT_TREE)/drivers/usb/typec/Kconfig"

endif # USB_SUPPORT
```

## drivers/usb/typec/Kconfig
```kconfig
# SPDX-License-Identifier: GPL-2.0

if TYPEC

source "$(KBUILD_EXT_TREE)/drivers/usb/typec/tcpm/Kconfig"

endif # TYPEC
```

## drivers/video/Kconfig
```kconfig
# SPDX-License-Identifier: GPL-2.0-only
#
# Video configuration
#

if HAS_IOMEM

source "$(KBUILD_EXT_TREE)/drivers/gpu/exynos/Kconfig"

endif
```

## sound/soc/codecs/Kconfig
```kconfig
# SPDX-License-Identifier: GPL-2.0-only

config SND_SOC_GS101
	tristate "ASoC Codec drivers for GS101 devices"
	depends on I2C
	depends on GPIOLIB
	select SND_SOC_RT5682_I2C
	select SND_SOC_MAX98357A
	help
	  Enable suppport for ASoC Codecs for GS101 devices. This selects all
	  of the necessary codecs for GS101 SoCs.
	  Select Y/M for GS101 SoCs
```
